## arch/arm64/um/Kconfig
```kconfig
# SPDX-License-Identifier: GPL-2.0

config UML_ARM64
	def_bool y

config 64BIT
	def_bool y

config MODULES_USE_ELF_RELA
	def_bool y

config 3_LEVEL_PGTABLES
	def_bool y
	help
	  arm64 UML uses a 39-bit VA (512 GB) user address space with
	  3-level page tables (4K pages, PGD/PUD/PMD).  This mirrors
	  the default arm64 kernel configuration and matches TASK_SIZE.

# arm64 always uses rt_sigframe (no classic sigframe)
config ARCH_HAS_SC_SIGNALS
	def_bool n

# arm64 does not reuse host vsyscall area
config ARCH_REUSE_HOST_VSYSCALL_AREA
	def_bool n

config GENERIC_HWEIGHT
	def_bool y

config ARCH_WANT_DEFAULT_TOPDOWN_MMAP_LAYOUT
	def_bool y

# arm64 always uses generic checksum (no hardware-specific csum asm in UML)
config GENERIC_CSUM
	def_bool y

config GENERIC_CALIBRATE_DELAY
	def_bool y

# ── arm64 hardware features NOT applicable to UML ─────────────────────────
#
# These would pull in arch/arm64/lib/ or hardware-specific code that cannot
# run in UML (userspace process). Explicitly disabled here.

# No persistent memory / DC CVAP instructions in UML
# (would require ARCH_HAS_UACCESS_FLUSHCACHE + arch/arm64/lib/uaccess_flushcache.c)
config ARM64_PMEM
	def_bool n

# No hardware memory tagging (MTE) in UML
config ARM64_MTE
	def_bool n

# No NEON/SVE in UML kernel context
# (UML runs as a userspace process; host kernel controls FP state)
config KERNEL_MODE_NEON
	def_bool n

# No hardware RNG (RNDR instruction) in UML
config ARCH_RANDOM
	def_bool n

# No PAC (Pointer Authentication) in UML kernel
# (host kernel handles PAC for the UML process itself)
config ARM64_PTR_AUTH
	def_bool n

config ARM64_PTR_AUTH_KERNEL
	def_bool n

# No Branch Target Identification in UML
config ARM64_BTI_KERNEL
	def_bool n
```

## arch/um/configs/arm64_defconfig
```kconfig
# ============================================================
#  DevBox UML arm64 — arm64_defconfig
#  Target: Android arm64, no root, no KVM
#
#  Strategy: semua config di-enable dulu, fix semua error,
#  lalu comment yang tidak dipakai di production.
#
#  Fase 1:  Boot to Debian                    ✅
#  Fase 2:  Namespace & cgroup isolation      ✅ config ready
#  Fase 3:  Docker-ready                      ✅ config ready
#  Fase 4:  Performance & hostfs              partial
# ============================================================

# ── Core ─────────────────────────────────────────────────────
CONFIG_UML=y
CONFIG_64BIT=y
# CONFIG_SMP is not set
CONFIG_BUG=y
CONFIG_PRINTK=y
CONFIG_CC_OPTIMIZE_FOR_SIZE=y

# ── Kernel features ───────────────────────────────────────────
CONFIG_NO_HZ=y
CONFIG_HIGH_RES_TIMERS=y
CONFIG_SYSVIPC=y
CONFIG_POSIX_MQUEUE=y
CONFIG_CROSS_MEMORY_ATTACH=y

# ── Modules ──────────────────────────────────────────────────
CONFIG_MODULES=y
CONFIG_MODULE_UNLOAD=y
CONFIG_MODULE_FORCE_UNLOAD=y
CONFIG_MODVERSIONS=y
# TODO: re-enable after asm/asm-prototypes.h override is complete
# (currently memcpy/memmove/memset CRC generation fails → unpredictable module load)

# ── Fase 2: Namespaces ────────────────────────────────────────
CONFIG_NAMESPACES=y
CONFIG_UTS_NS=y
CONFIG_IPC_NS=y
CONFIG_NET_NS=y
CONFIG_USER_NS=y
# CONFIG_PID_NS is not set   # known UML issue: breaks init

# ── Fase 2: Cgroups ──────────────────────────────────────────
CONFIG_CGROUPS=y
CONFIG_CGROUP_FREEZER=y
CONFIG_CGROUP_DEVICE=y
CONFIG_CGROUP_CPUACCT=y
CONFIG_CGROUP_SCHED=y
CONFIG_CGROUP_PIDS=y
CONFIG_CGROUP_RDMA=y
CONFIG_CGROUP_HUGETLB=y
CONFIG_CGROUP_NET_PRIO=y
CONFIG_CGROUP_NET_CLASSID=y
CONFIG_BLK_CGROUP=y
CONFIG_MEMCG=y
CONFIG_CPUSETS=y

# ── Security ─────────────────────────────────────────────────
CONFIG_SECCOMP=y
CONFIG_SECCOMP_FILTER=y
CONFIG_SECURITY=y
CONFIG_SECURITY_NETWORK=y
CONFIG_KEYS=y
CONFIG_KEYS_REQUEST_CACHE=y
# CONFIG_KASAN is not set
# CONFIG_KCOV is not set

# ── BPF ──────────────────────────────────────────────────────
CONFIG_BPF_SYSCALL=y
CONFIG_BPF_JIT=y
CONFIG_CGROUP_BPF=y
CONFIG_BPF_LSM=y
CONFIG_BPF_EVENTS=y

# ── UML device drivers ────────────────────────────────────────
CONFIG_DEVTMPFS=y
CONFIG_DEVTMPFS_MOUNT=y
CONFIG_UML_RANDOM=y
CONFIG_UNIX98_PTYS=y
CONFIG_LEGACY_PTY_COUNT=32

# ── Block devices ─────────────────────────────────────────────
CONFIG_BLK_DEV_UBD=y
CONFIG_BLK_DEV_LOOP=y
CONFIG_BLK_DEV_NBD=y
CONFIG_BLK_DEV_RAM=y

# ── UML console channels ─────────────────────────────────────
CONFIG_SSL=y
CONFIG_STDERR_CONSOLE=y
CONFIG_NULL_CHAN=y
CONFIG_PORT_CHAN=y
CONFIG_PTY_CHAN=y
CONFIG_TTY_CHAN=y
CONFIG_XTERM_CHAN=y
CONFIG_CON_CHAN="pts"
CONFIG_SSL_CHAN="pts"

# ── Networking core ──────────────────────────────────────────
CONFIG_NET=y
CONFIG_INET=y
CONFIG_IP_MULTICAST=y
CONFIG_IP_ADVANCED_ROUTER=y
CONFIG_IP_ROUTE_MULTIPATH=y
CONFIG_PACKET=y
CONFIG_UNIX=y
CONFIG_UNIX_SCM=y
CONFIG_IPV6=y
CONFIG_IPV6_ROUTER_PREF=y
CONFIG_NETFILTER=y
CONFIG_NF_CONNTRACK=y
CONFIG_NF_CONNTRACK_IPV4=y
CONFIG_NF_TABLES=y
CONFIG_NF_TABLES_INET=y
CONFIG_NFT_CONNLIMIT=y
CONFIG_NFT_NAT=y
CONFIG_NF_NAT=y
CONFIG_IP_NF_IPTABLES=y
CONFIG_IP_NF_FILTER=y
CONFIG_IP_NF_TARGET_REJECT=y
CONFIG_IP_NF_NAT=y
CONFIG_IP_NF_TARGET_MASQUERADE=y
CONFIG_IP6_NF_IPTABLES=y
CONFIG_IP6_NF_FILTER=y
CONFIG_NETLINK_DIAG=y
CONFIG_INET_DIAG=y
CONFIG_INET_TCP_DIAG=y
CONFIG_INET_UDP_DIAG=y
CONFIG_TCP_CONG_ADVANCED=y

# ── UML network backends ─────────────────────────────────────
CONFIG_UML_NET=y
CONFIG_UML_NET_SLIRP=y
CONFIG_UML_NET_TUNTAP=y
CONFIG_UML_NET_DAEMON=y
CONFIG_UML_NET_MCAST=y

# ── Fase 3: Container networking ─────────────────────────────
CONFIG_TUN=y
CONFIG_VETH=y
CONFIG_BRIDGE=y
CONFIG_BRIDGE_NETFILTER=y
CONFIG_DUMMY=y
CONFIG_MACVLAN=y
CONFIG_IPVLAN=y
CONFIG_NET_SCHED=y
CONFIG_NET_SCH_DEFAULT=y
CONFIG_NET_SCH_FQ_CODEL=y
CONFIG_NET_SCH_FQ=y
CONFIG_NET_SCH_INGRESS=y
CONFIG_NET_CLS_BPF=y
CONFIG_NET_ACT_BPF=y

# ── Filesystems ───────────────────────────────────────────────
CONFIG_BINFMT_ELF=y
CONFIG_BINFMT_SCRIPT=y
CONFIG_BINFMT_MISC=y
CONFIG_EXT4_FS=y
CONFIG_EXT4_USE_FOR_EXT2=y
CONFIG_EXT4_FS_POSIX_ACL=y
CONFIG_EXT4_FS_SECURITY=y
CONFIG_PROC_FS=y
CONFIG_PROC_KCORE=y
CONFIG_SYSFS=y
CONFIG_TMPFS=y
CONFIG_TMPFS_POSIX_ACL=y
CONFIG_HOSTFS=y

# ── Fase 3: Overlay (Docker layers) ──────────────────────────
CONFIG_OVERLAY_FS=y
CONFIG_OVERLAY_FS_REDIRECT_DIR=y
CONFIG_OVERLAY_FS_INDEX=y

# ── Optional filesystems (=m → fix undefined errors first) ───
CONFIG_SQUASHFS=y
CONFIG_SQUASHFS_ZLIB=y
CONFIG_SQUASHFS_LZ4=y
CONFIG_SQUASHFS_LZO=y
CONFIG_SQUASHFS_XZ=y
CONFIG_SQUASHFS_ZSTD=y
CONFIG_FUSE_FS=y
CONFIG_CUSE=y
CONFIG_VIRTIO_FS=y
CONFIG_ISO9660_FS=y
CONFIG_JOLIET=y
CONFIG_VFAT_FS=y
CONFIG_FAT_DEFAULT_UTF8=y
CONFIG_F2FS_FS=y
CONFIG_EROFS_FS=y
CONFIG_XFS_FS=y
CONFIG_BTRFS_FS=y
CONFIG_NFS_FS=y
CONFIG_NFS_V4=y
CONFIG_NFSD=y
CONFIG_CIFS=y
CONFIG_NLS=y
CONFIG_NLS_UTF8=y
CONFIG_NLS_ISO8859_1=y

# ── Crypto ───────────────────────────────────────────────────
CONFIG_CRYPTO=y
CONFIG_CRYPTO_HASH=y
CONFIG_CRYPTO_AES=y
CONFIG_CRYPTO_SHA256=y
CONFIG_CRYPTO_SHA512=y
CONFIG_CRYPTO_MD5=y
CONFIG_CRYPTO_DEFLATE=y
CONFIG_CRYPTO_LZ4=y
CONFIG_CRYPTO_ZSTD=y

# ── Compression libs ─────────────────────────────────────────
CONFIG_ZLIB_INFLATE=y
CONFIG_ZLIB_DEFLATE=y
CONFIG_LZ4_COMPRESS=y
CONFIG_LZ4_DECOMPRESS=y
CONFIG_ZSTD_COMPRESS=y
CONFIG_ZSTD_DECOMPRESS=y

# ── Syscall features ─────────────────────────────────────────
CONFIG_INOTIFY_USER=y
CONFIG_FANOTIFY=y
CONFIG_FANOTIFY_ACCESS_PERMISSIONS=y
CONFIG_TIMERFD=y
CONFIG_SIGNALFD=y
CONFIG_EVENTFD=y
CONFIG_EPOLL=y
CONFIG_FUTEX=y
CONFIG_AIO=y
CONFIG_IO_URING=y
CONFIG_USERFAULTFD=y
CONFIG_MEMBARRIER=y


# ── Audit ─────────────────────────────────────────────────────
# systemd requires audit subsystem
CONFIG_AUDIT=y
CONFIG_AUDITSYSCALL=y

# ── Scheduler ────────────────────────────────────────────────
CONFIG_SCHED_AUTOGROUP=y

# ── Memory ───────────────────────────────────────────────────
# KSM: kernel same-page merging — useful for phone (low RAM)
CONFIG_KSM=y
# Transparent hugepages — performance
CONFIG_TRANSPARENT_HUGEPAGE=y
CONFIG_TRANSPARENT_HUGEPAGE_MADVISE=y

# ── Crypto: ARM64 CE (hardware-accelerated via ARMv8 crypto extensions) ───────
# These use ARM64 NEON/CE instructions — faster than software fallback
# NOTE: Only works on real arm64 hardware. UML may or may not forward CE insns.
# If CE not available, kernel silently falls back to software implementation.
CONFIG_CRYPTO_GHASH_ARM64_CE=y
CONFIG_CRYPTO_SHA1_ARM64_CE=y
CONFIG_CRYPTO_SHA2_ARM64_CE=y
CONFIG_CRYPTO_SHA512_ARM64_CE=m
CONFIG_CRYPTO_AES_ARM64_CE_BLK=y
CONFIG_CRYPTO_AES_ARM64_CE_CCM=y
CONFIG_CRYPTO_CHACHA20_NEON=m

# ── Filesystem extras ────────────────────────────────────────
# configfs — systemd/containers need this
CONFIG_CONFIGFS_FS=y
# autofs — systemd automount
CONFIG_AUTOFS_FS=y
# ubifs — optional, useful for compressed storage
CONFIG_UBIFS_FS=m

# ── Networking extras ────────────────────────────────────────
# VLAN — container networking
CONFIG_VLAN_8021Q=y
CONFIG_VLAN_8021Q_GVRP=y
CONFIG_BRIDGE_VLAN_FILTERING=y
# IPVS — load balancer (useful for k3s/container orchestration future)
CONFIG_IP_VS=m

# ── Debug helpers ────────────────────────────────────────────
CONFIG_MAGIC_SYSRQ=y
CONFIG_IKCONFIG=y
CONFIG_IKCONFIG_PROC=y
CONFIG_DEBUG_KERNEL=y

# ── Rust support ──────────────────────────────────────────────────────────────
# Requires: rustc 1.78.0+, bindgen 0.65.1+, rust-src component
# Installed via rustup in build scripts (apt version too old)
CONFIG_RUST=y
```
